/* Copyright (c) 2017, The Linux Foundation. All rights reserved.
 *
 * This program is free software; you can redistribute it and/or modify
 * it under the terms of the GNU General Public License version 2 and
 * only version 2 as published by the Free Software Foundation.
 *
 * This program is distributed in the hope that it will be useful,
 * but WITHOUT ANY WARRANTY; without even the implied warranty of
 * MERCHANTABILITY or FITNESS FOR A PARTICULAR PURPOSE.  See the
 * GNU General Public License for more details.
 */

/dts-v1/;
/plugin/;

#include "ZS600KL-PR1_AC-asus-overlay.dts"

/ {
	model = "Qualcomm Technologies, Inc. SDM845 v2 JEDI MP_AC";
	compatible = "qcom,sdm845-mtp", "qcom,sdm845", "qcom,mtp";
	qcom,msm-id = <321 0x20000>;
	qcom,board-id = <100 0>;
};



/*    ====================================
 *    overlay for SDM845-v2.dtsi/SDM845.dtsi - start
 *    ====================================
 */



/*    ====================================
 *    overlay for SDM845-v2.dtsi/SDM845.dtsi - end
 *    ====================================
 */
/*    ====================================
 *    overlay for sdm845-mtp.dtsi - start
 *    ====================================
 */



/*    ====================================
 *    overlay for sdm845-mtp.dtsi - end
 *    ====================================
 */
/*    ====================================
 *    overlay for pmi8998.dtsi/pm8998.dtsi - start
 *    ====================================
 */



/*    ====================================
 *    overlay for pmi8998.dtsi/pm8998.dtsi - end
 *    ====================================
 */
/*    ====================================
 *    overlay for sdm845-pinctrl.dtsi - start
 *    ====================================
 */



/*    ====================================
 *    overlay for sdm845-pinctrl.dtsi - end
 *    ====================================
 */
/*    ====================================
 *    overlay for sdm845-regulator.dtsi - start
 *    ====================================
 */



/*    ====================================
 *    overlay for sdm845-regulator.dtsi - end
 *    ====================================
 */
/*    ====================================
 *    overlay for sdm845-camera.dtsi - start
 *    ====================================
 */


/*    ====================================
 *    overlay for sdm845-camera.dtsi - end
 *    ====================================
 */
/*    ====================================
 *    overlay for sdm845-audio.dtsi - start
 *    ====================================
 */



/*    ====================================
 *    overlay for sdm845-audio.dtsi - end
 *    ====================================
 */
/*    ====================================
 *    overlay for sdm845-audio-overlay.dtsi - start
 *    ====================================
 */



/*    ====================================
 *    overlay for sdm845-audio-overlay.dtsi - end
 *    ====================================
 */

 
