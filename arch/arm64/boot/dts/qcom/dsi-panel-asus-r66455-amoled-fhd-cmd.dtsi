/* Copyright (c) 2016-2017, The Linux Foundation. All rights reserved.
 *
 * This program is free software; you can redistribute it and/or modify
 * it under the terms of the GNU General Public License version 2 and
 * only version 2 as published by the Free Software Foundation.
 *
 * This program is distributed in the hope that it will be useful,
 * but WITHOUT ANY WARRANTY; without even the implied warranty of
 * MERCHANTABILITY or FITNESS FOR A PARTICULAR PURPOSE.  See the
 * GNU General Public License for more details.
 */

&mdss_mdp {
	dsi_r66455_fhd_cmd: qcom,mdss_dsi_r66455_fhd_cmd_display{
		qcom,mdss-dsi-panel-name =
			"ASUS TM r66455 cmd fhd amoled panel";
		qcom,mdss-dsi-panel-type = "dsi_cmd_mode";
		qcom,mdss-dsi-panel-framerate = <90>;
		qcom,mdss-dsi-virtual-channel-id = <0>;
		qcom,mdss-dsi-stream = <0>;
		qcom,mdss-dsi-bpp = <24>;
		qcom,mdss-dsi-color-order = "rgb_swap_rgb";
		qcom,mdss-dsi-underflow-color = <0xff>;
		qcom,mdss-dsi-border-color = <0>;
		qcom,mdss-dsi-traffic-mode = "non_burst_sync_event";
		qcom,mdss-dsi-lane-0-state;
		qcom,mdss-dsi-lane-1-state;
		qcom,mdss-dsi-lane-2-state;
		qcom,mdss-dsi-lane-3-state;
		qcom,adjust-timer-wakeup-ms = <1>;
		qcom,mdss-dsi-reset-sequence = <1 10>, <0 10>, <1 0>;
		qcom,mdss-pan-physical-width-dimension = <68>; // 68.261 (active area)
		qcom,mdss-pan-physical-height-dimension = <136>; // 136.51 (active area)
		qcom,mdss-dsi-dma-trigger = "trigger_sw";
		qcom,mdss-dsi-mdp-trigger = "none";
		qcom,mdss-dsi-lp11-init;
		qcom,mdss-dsi-wr-mem-start = <0x2c>;
		qcom,mdss-dsi-wr-mem-continue = <0x3c>;
		qcom,mdss-dsi-te-pin-select = <1>;
		qcom,mdss-dsi-te-dcs-command = <1>;
		qcom,mdss-dsi-te-check-enable;
		qcom,mdss-dsi-te-using-te-pin;
		qcom,mdss-dsi-panel-hdr-enabled;
		qcom,mdss-dsi-panel-hdr-color-primaries = <14500 15500 32000
			17000 15500 30000 8000 3000>;
		qcom,mdss-dsi-panel-peak-brightness = <4200000>;
		qcom,mdss-dsi-panel-blackness-level = <3230>;
		qcom,mdss-dsi-pan-enable-dynamic-fps;
		qcom,mdss-dsi-pan-fps-update =
			"dfps_immediate_porch_mode_vfp";
		qcom,dsi-supported-dfps-list = <90 60>;

		qcom,mdss-dsi-t-clk-post = <0x0B>;
		qcom,mdss-dsi-t-clk-pre = <0x24>;

		qcom,mdss-dsi-display-timings {
			timing@0{
				qcom,mdss-dsi-panel-framerate = <90>;
				qcom,mdss-dsi-panel-clockrate = <576000000>;
				qcom,mdss-dsi-panel-width = <1080>;
				qcom,mdss-dsi-panel-height = <2160>;
				qcom,mdss-dsi-h-front-porch = <44>;
				qcom,mdss-dsi-h-back-porch = <56>;
				qcom,mdss-dsi-h-pulse-width = <4>;
				qcom,mdss-dsi-h-sync-skew = <0>;
				qcom,mdss-dsi-v-back-porch = <6>;
				qcom,mdss-dsi-v-front-porch = <6>;
				qcom,mdss-dsi-v-pulse-width = <12>;
				qcom,mdss-dsi-h-left-border = <0>;
				qcom,mdss-dsi-h-right-border = <0>;
				qcom,mdss-dsi-v-top-border = <0>;
				qcom,mdss-dsi-v-bottom-border = <0>;
				qcom,mdss-dsi-h-sync-pulse = <0>;
				qcom,mdss-dsi-panel-jitter = <0xa 0x1>;
				qcom,mdss-dsi-panel-phy-timings = [00 15 05 05 20 1F 05
					05 03 03 04 00];
				qcom,mdss-dsi-on-command = [
					15 01 00 00 00 00 02 B0 00
					39 01 00 00 00 00 09 B3 00 00 02 02 08 00 10 00
					39 01 00 00 00 00 20 C2 00 08 70 00 0C 00 04 00 0C 00 04 00 0C 00 04 00 0C 00 04 00 0C 00 04 08 70 00 02 00 00 00 6C
					39 01 00 00 00 00 1F C4 70 00 00 00 00 00 01 00 22 00 22 00 01 00 00 00 00 00 00 00 00 00 00 00 00 00 10 00 00 03
					39 01 00 00 00 00 86 CF 64 0B 00 00 00 00 00 00 00 00 0c 81 02 02 02 02 02 02 02 02 02 02 03 03 00 00 00 00 00 00 00 00 00 00 00 00 00 00 00 00 00 00 03 FF 03 1F 03 FF 00 00 00 00 00 00 00 00 00 00 00 00 00 00 00 00 00 00 03 FF 03 1F 03 FF 01 1A 01 1A 01 1A 01 1A 01 1A 01 1A 01 1A 01 1A 01 1A 01 1A 01 1A 01 1A 1A 1A 1A 1A 1A 1A 1A 1A 1A 1A 1A 1A 09 9A 09 9A 09 9A 09 9A 09 9A 09 9A 09 9A 09 9A 09 9A 09 9A 09 9A 09 9A 19
					15 01 00 00 00 00 02 D6 04
					39 01 00 00 00 00 E6 D7 03 00 03 0C F0 FF 00 08 FF 00 00 00 01 00 01 02 00 01 00 88 00 02 00 00 00 00 00 00 00 00 00 00 00 00 00 00 01 00 03 0C F0 FF 00 08 2E 02 00 00 01 00 03 0A F0 FF 00 08 2E 02 00 00 00 00 01 0C F0 FF 2E 08 1A 02 00 00 00 00 01 0B F0 FF 2E 08 1A 02 00 00 00 00 00 00 00 00 00 00 00 00 00 00 00 00 00 00 00 00 00 00 00 00 00 00 01 00 03 0B F0 FF 00 08 2E 02 00 00 03 00 03 0C F0 FF 2E 08 00 01 00 00 00 00 00 00 00 00 00 00 00 00 00 00 00 00 00 00 00 00 00 00 00 00 00 00 00 00 00 00 00 00 00 00 00 00 00 00 00 00 00 00 00 00 00 00 00 00 00 00 00 00 00 00 00 00 00 00 00 00 00 00 00 00 00 00 00 00 00 00 00 00 00 00 00 00 00 00 00 00 00 00 00 00 00 00 00 00 00 00 00 00 00 00 00 00 00 00 00
					39 01 00 00 00 00 26 D8 00 01 00 1D 00 06 74 00 4D 74 00 74 00 74 00 5C 00 FF 09 00 1D 00 00 00 00 00 00 00 00 00 00 00 00 00 00 00 00
					/* DSC */
					15 01 00 00 00 00 02 F7 01
					39 01 00 00 00 00 03 EB 8B 8B
					/* DSC */
					15 01 00 00 00 00 02 53 2C
					39 01 00 00 00 00 03 44 08 5c
					15 01 00 00 00 00 02 35 00
					15 01 00 00 00 00 02 B0 80
					15 01 00 00 00 00 02 E6 01
					39 01 00 00 00 00 72 E4 DC 82 00 40 55 55 01 40 55 55 01 00 00 00 00 40 55 55 01 40 55 55 01 40 55 55 01 40 55 55 01 00 00 00 00 00 00 00 00 40 55 55 01 3F 55 55 FD 00 00 00 00 00 00 00 00 00 00 00 00 00 00 00 00 00 00 00 00 00 00 00 00 40 55 55 01 00 00 3F C0 00 66 60 66 06 00 00 00 00 06 06 00 00 00 00 60 60 00 00 00 00 60 66 06 66 F3 00 33 07 00 00 00 00 00
					05 01 00 00 78 00 02 11 00
					05 01 00 00 00 00 02 29 00
					15 01 00 00 00 00 02 B0 00
					39 01 00 00 00 00 2F BB 59 C8 C8 C8 C8 C8 C8 C8 C8 C8 4A 48 46 44 42 40 3E 3C 3A 00 FF FF FF FF FF FF FF FF FF 04 00 02 02 46 04 69 5A 00 0C 80 0F FF 0F FF 0F FF
					07 01 00 00 10 00 02 01 00
					39 01 00 00 01 00 05 2A 00 00 04 37
					39 01 00 00 01 00 05 2B 00 00 08 6F
					];
				qcom,mdss-dsi-off-command = [
					05 01 00 00 00 00 02 28 00
					05 01 00 00 78 00 02 10 00
					];
				/* add for dfps +++ */
				qcom,mdss-dsi-on-60-command = [
					15 01 00 00 00 00 02 B0 00
					39 01 00 00 00 00 09 B3 00 00 02 02 08 00 10 00
					39 01 00 00 00 00 20 C2 00 08 70 00 0C 00 04 00 0C 00 04 00 0C 00 04 00 08 00 08 00 08 00 08 09 60 00 02 00 00 00 6C
					39 01 00 00 00 00 1F C4 70 00 00 00 00 00 01 00 2C 00 2C 00 01 00 00 00 00 00 00 00 00 00 00 00 00 00 10 00 00 03
					39 01 00 00 00 00 86 CF 64 0B 00 00 00 00 00 00 00 00 0c 81 04 04 04 04 04 04 04 04 04 04 05 05 00 00 00 00 00 00 00 00 00 00 00 00 00 00 00 00 00 00 03 FF 03 1F 03 FF 00 00 00 00 00 00 00 00 00 00 00 00 00 00 00 00 00 00 03 FF 03 1F 03 FF 01 1A 01 1A 01 1A 01 1A 01 1A 01 1A 01 1A 01 1A 01 1A 01 1A 01 1A 01 1A 1A 1A 1A 1A 1A 1A 1A 1A 1A 1A 1A 1A 09 9A 09 9A 09 9A 09 9A 09 9A 09 9A 09 9A 09 9A 09 9A 09 9A 09 9A 09 9A 19
					15 01 00 00 00 00 02 D6 00
					39 01 00 00 00 00 E6 D7 03 00 03 0C F0 FF 00 08 FF 00 00 00 01 00 01 02 00 01 00 88 00 02 00 00 00 00 00 00 00 00 00 00 00 00 00 00 01 00 03 0C F0 FF 00 08 46 02 00 00 01 00 03 0A F0 FF 00 08 46 02 00 00 00 00 01 0C F0 FF 4C 08 1F 02 00 00 00 00 01 0B F0 FF 4C 08 1F 02 00 00 00 00 00 00 00 00 00 00 00 00 00 00 00 00 00 00 00 00 00 00 00 00 00 00 01 00 03 0B F0 FF 00 08 46 02 00 00 03 00 03 0C F0 FF 46 08 00 01 00 00 00 00 00 00 00 00 00 00 00 00 00 00 00 00 00 00 00 00 00 00 00 00 00 00 00 00 00 00 00 00 00 00 00 00 00 00 00 00 00 00 00 00 00 00 00 00 00 00 00 00 00 00 00 00 00 00 00 00 00 00 00 00 00 00 00 00 00 00 00 00 00 00 00 00 00 00 00 00 00 00 00 00 00 00 00 00 00 00 00 00 00 00 00 00 00 00 00
					39 01 00 00 00 00 26 D8 00 01 00 26 00 08 76 00 46 74 00 74 00 69 00 5C 00 FF 09 00 26 00 00 00 00 00 00 00 00 00 00 00 00 00 00 00 00
					/* DSC */
					15 01 00 00 00 00 02 F7 01
					39 01 00 00 00 00 03 EB 8B 8B
					/* DSC */
					15 01 00 00 00 00 02 53 2C
					39 01 00 00 00 00 03 44 08 5c
					15 01 00 00 00 00 02 35 00
					15 01 00 00 00 00 02 B0 80
					15 01 00 00 00 00 02 E6 01
					05 01 00 00 78 00 02 11 00
					05 01 00 00 00 00 02 29 00
					15 01 00 00 00 00 02 B0 00
					39 01 00 00 00 00 2F BB 59 C8 C8 C8 C8 C8 C8 C8 C8 C8 4A 48 46 44 42 40 3E 3C 3A 00 FF FF FF FF FF FF FF FF FF 04 00 01 01 06 04 69 5A 00 0C 80 0F FF 0F FF 0F FF
					07 01 00 00 10 00 02 01 00
					39 01 00 00 01 00 05 2A 00 00 04 37
					39 01 00 00 01 00 05 2B 00 00 08 6F
					];
				qcom,mdss-dsi-60-command = [
					15 01 00 00 00 00 02 B0 00
					39 01 00 00 00 00 09 B3 00 00 02 02 08 00 10 00
					39 01 00 00 00 00 20 C2 00 08 70 00 0C 00 04 00 0C 00 04 00 0C 00 04 00 08 00 08 00 08 00 08 09 60 00 02 00 00 00 6C
					39 01 00 00 00 00 1F C4 70 00 00 00 00 00 01 00 2C 00 2C 00 01 00 00 00 00 00 00 00 00 00 00 00 00 00 10 00 00 03
					39 01 00 00 00 00 86 CF 64 0B 00 00 00 00 00 00 00 00 0c 81 04 04 04 04 04 04 04 04 04 04 05 05 00 00 00 00 00 00 00 00 00 00 00 00 00 00 00 00 00 00 03 FF 03 1F 03 FF 00 00 00 00 00 00 00 00 00 00 00 00 00 00 00 00 00 00 03 FF 03 1F 03 FF 01 1A 01 1A 01 1A 01 1A 01 1A 01 1A 01 1A 01 1A 01 1A 01 1A 01 1A 01 1A 1A 1A 1A 1A 1A 1A 1A 1A 1A 1A 1A 1A 09 9A 09 9A 09 9A 09 9A 09 9A 09 9A 09 9A 09 9A 09 9A 09 9A 09 9A 09 9A 19
					15 01 00 00 00 00 02 D6 00
					39 01 00 00 00 00 E6 D7 03 00 03 0C F0 FF 00 08 FF 00 00 00 01 00 01 02 00 01 00 88 00 02 00 00 00 00 00 00 00 00 00 00 00 00 00 00 01 00 03 0C F0 FF 00 08 46 02 00 00 01 00 03 0A F0 FF 00 08 46 02 00 00 00 00 01 0C F0 FF 4C 08 1F 02 00 00 00 00 01 0B F0 FF 4C 08 1F 02 00 00 00 00 00 00 00 00 00 00 00 00 00 00 00 00 00 00 00 00 00 00 00 00 00 00 01 00 03 0B F0 FF 00 08 46 02 00 00 03 00 03 0C F0 FF 46 08 00 01 00 00 00 00 00 00 00 00 00 00 00 00 00 00 00 00 00 00 00 00 00 00 00 00 00 00 00 00 00 00 00 00 00 00 00 00 00 00 00 00 00 00 00 00 00 00 00 00 00 00 00 00 00 00 00 00 00 00 00 00 00 00 00 00 00 00 00 00 00 00 00 00 00 00 00 00 00 00 00 00 00 00 00 00 00 00 00 00 00 00 00 00 00 00 00 00 00 00 00
					39 01 00 00 00 00 26 D8 00 01 00 26 00 08 76 00 46 74 00 74 00 69 00 5C 00 FF 09 00 26 00 00 00 00 00 00 00 00 00 00 00 00 00 00 00 00
					];
				qcom,mdss-dsi-90-command = [
					15 01 00 00 00 00 02 B0 00
					39 01 00 00 00 00 09 B3 00 00 02 02 08 00 10 00
					39 01 00 00 00 00 20 C2 00 08 70 00 0C 00 04 00 0C 00 04 00 0C 00 04 00 0C 00 04 00 0C 00 04 08 70 00 02 00 00 00 6C
					39 01 00 00 00 00 1F C4 70 00 00 00 00 00 01 00 22 00 22 00 01 00 00 00 00 00 00 00 00 00 00 00 00 00 10 00 00 03
					39 01 00 00 00 00 86 CF 64 0B 00 00 00 00 00 00 00 00 0c 81 02 02 02 02 02 02 02 02 02 02 03 03 00 00 00 00 00 00 00 00 00 00 00 00 00 00 00 00 00 00 03 FF 03 1F 03 FF 00 00 00 00 00 00 00 00 00 00 00 00 00 00 00 00 00 00 03 FF 03 1F 03 FF 01 1A 01 1A 01 1A 01 1A 01 1A 01 1A 01 1A 01 1A 01 1A 01 1A 01 1A 01 1A 1A 1A 1A 1A 1A 1A 1A 1A 1A 1A 1A 1A 09 9A 09 9A 09 9A 09 9A 09 9A 09 9A 09 9A 09 9A 09 9A 09 9A 09 9A 09 9A 19
					15 01 00 00 00 00 02 D6 04
					39 01 00 00 00 00 E6 D7 03 00 03 0C F0 FF 00 08 FF 00 00 00 01 00 01 02 00 01 00 88 00 02 00 00 00 00 00 00 00 00 00 00 00 00 00 00 01 00 03 0C F0 FF 00 08 2E 02 00 00 01 00 03 0A F0 FF 00 08 2E 02 00 00 00 00 01 0C F0 FF 2E 08 1A 02 00 00 00 00 01 0B F0 FF 2E 08 1A 02 00 00 00 00 00 00 00 00 00 00 00 00 00 00 00 00 00 00 00 00 00 00 00 00 00 00 01 00 03 0B F0 FF 00 08 2E 02 00 00 03 00 03 0C F0 FF 2E 08 00 01 00 00 00 00 00 00 00 00 00 00 00 00 00 00 00 00 00 00 00 00 00 00 00 00 00 00 00 00 00 00 00 00 00 00 00 00 00 00 00 00 00 00 00 00 00 00 00 00 00 00 00 00 00 00 00 00 00 00 00 00 00 00 00 00 00 00 00 00 00 00 00 00 00 00 00 00 00 00 00 00 00 00 00 00 00 00 00 00 00 00 00 00 00 00 00 00 00 00 00
					39 01 00 00 00 00 26 D8 00 01 00 1D 00 06 74 00 4D 74 00 74 00 74 00 5C 00 FF 09 00 1D 00 00 00 00 00 00 00 00 00 00 00 00 00 00 00 00
					];
				/* add for dfps --- */

				/* add for pr-stage +++ */
				qcom,mdss-dsi-on-60-pr-command = [
					15 01 00 00 00 00 02 B0 00
					39 01 00 00 00 00 09 B3 00 00 02 02 08 00 10 00
					39 01 00 00 00 00 20 C2 00 08 70 00 0C 00 04 00 0C 08 84 00 0C 00 04 00 08 00 08 00 08 00 08 09 60 00 02 00 00 00 6C
					39 01 00 00 00 00 1F C4 70 00 00 00 00 00 01 00 2C 00 2C 00 01 00 00 00 00 00 00 00 00 00 00 00 00 00 10 00 00 03
					39 01 00 00 00 00 86 CF 64 0B 00 00 00 00 00 00 03 20 0C 81 04 04 04 04 04 04 04 04 04 04 04 05 00 FF 00 FF 00 FF 00 FF 00 FF 00 FF 00 FF 00 FF 00 FF 03 FF 03 FF 03 FF 00 FF 00 FF 00 FF 00 FF 00 FF 00 FF 00 FF 00 FF 00 FF 03 FF 03 FF 03 FF 01 35 01 35 01 35 01 35 01 35 01 35 01 35 01 35 01 35 01 35 01 35 01 35 1C 1C 1C 1C 1C 1C 1C 1C 1C 1C 1C 1C 09 9A 09 9A 09 9A 09 9A 09 9A 09 9A 00 00 09 9A 09 9A 09 9A 09 9A 09 9A 19
					15 01 00 00 00 00 02 D6 00
					39 01 00 00 00 00 E6 D7 03 00 03 0C F0 FF 00 08 FF 00 00 00 01 00 01 02 00 01 00 88 00 02 00 00 00 00 00 00 00 00 00 00 00 00 00 00 01 00 03 0C F0 FF 00 08 46 02 00 00 01 00 03 0A F0 FF 00 08 46 02 00 00 00 00 01 0C 80 73 3D 08 2F 02 00 00 00 00 01 0B 80 73 3D 08 2F 02 00 00 00 00 00 00 00 00 00 00 00 00 00 00 00 00 00 00 00 00 00 00 00 00 00 00 01 00 03 0B F0 FF 00 08 46 02 00 00 03 00 03 0C F0 FF 46 08 00 01 00 00 00 00 00 00 00 00 00 00 00 00 00 00 00 00 00 00 00 00 00 00 00 00 00 00 00 00 00 00 00 00 00 00 00 00 00 00 00 00 00 00 00 00 00 00 00 00 00 00 00 00 00 00 00 00 00 00 00 00 00 00 00 00 00 00 00 00 00 00 00 00 00 00 00 00 00 00 00 00 00 00 00 00 00 00 00 00 00 00 00 00 00 00 00 00 00 00 00
					39 01 00 00 00 00 26 D8 00 01 00 26 00 08 76 00 46 74 00 74 00 69 00 5C 00 FF 09 00 26 00 00 00 00 00 00 00 00 00 00 00 00 00 00 00 00
					39 01 00 00 00 00 32 D3 37 00 00 01 1A 37 00 00 01 1a 77 77 77 07 82 00 00 A0 3C AA 00 3E 67 70 10 01 03 33 04 44 07 77 33 33 13 04 00 00 00 00 00 00 00 3C 00 00 01 00 00
					 /* DSC */
					15 01 00 00 00 00 02 F7 01
					39 01 00 00 00 00 03 EB 8B 8B
					/* DSC */
					15 01 00 00 00 00 02 53 2C
					39 01 00 00 00 00 03 44 08 5c
					15 01 00 00 00 00 02 35 00
					15 01 00 00 00 00 02 B0 80
					15 01 00 00 00 00 02 E6 01
					05 01 00 00 78 00 02 11 00
					05 01 00 00 00 00 02 29 00
					15 01 00 00 00 00 02 B0 00
					39 01 00 00 00 00 2F BB 59 C8 C8 C8 C8 C8 C8 C8 C8 C8 4A 48 46 44 42 40 3E 3C 3A 00 FF FF FF FF FF FF FF FF FF 04 00 01 01 06 04 69 5A 00 0C 80 0F FF 0F FF 0F FF
					15 01 00 00 00 00 02 B0 80
					15 01 00 00 00 00 02 E3 2F //avdd=6.4
					07 01 00 00 10 00 02 01 00
					39 01 00 00 01 00 05 2A 00 00 04 37
					39 01 00 00 01 00 05 2B 00 00 08 6F
					];
				qcom,mdss-dsi-on-90-pr-command = [
					15 01 00 00 00 00 02 B0 00
					39 01 00 00 00 00 09 B3 00 00 02 02 08 00 10 00
					39 01 00 00 00 00 20 C2 00 08 70 00 0C 00 04 00 0C 08 84 00 0C 00 04 00 0C 00 04 00 0C 00 04 08 70 00 02 00 00 00 6C
					39 01 00 00 00 00 1F C4 70 00 00 00 00 00 01 00 22 00 22 00 01 00 00 00 00 00 00 00 00 00 00 00 00 00 10 00 00 03
					39 01 00 00 00 00 86 CF 64 0B 00 00 00 00 00 00 03 20 0C 81 02 02 02 02 02 02 02 02 02 02 02 03 00 FF 00 FF 00 FF 00 FF 00 FF 00 FF 00 FF 00 FF 00 FF 03 FF 03 FF 03 FF 00 FF 00 FF 00 FF 00 FF 00 FF 00 FF 00 FF 00 FF 00 FF 03 FF 03 FF 03 FF 01 1A 01 1A 01 1A 01 1A 01 1A 01 1A 01 1A 01 1A 01 1A 01 1A 01 1A 01 1A 1C 1C 1C 1C 1C 1C 1C 1C 1C 1C 1C 1C 09 9A 09 9A 09 9A 09 9A 09 9A 09 9A 00 00 09 9A 09 9A 09 9A 09 9A 09 9A 19
					15 01 00 00 00 00 02 D6 04
					39 01 00 00 00 00 E6 D7 03 00 03 0C F0 FF 00 08 FF 00 00 00 01 00 01 02 00 01 00 88 00 02 00 00 00 00 00 00 00 00 00 00 00 00 00 00 01 00 03 0C F0 FF 00 08 2E 02 00 00 01 00 03 0A F0 FF 00 08 2E 02 00 00 00 00 01 0C 80 73 2E 08 1A 02 00 00 00 00 01 0B 80 73 2E 08 1A 02 00 00 00 00 00 00 00 00 00 00 00 00 00 00 00 00 00 00 00 00 00 00 00 00 00 00 01 00 03 0B F0 FF 00 08 2E 02 00 00 03 00 03 0C F0 FF 2E 08 00 01 00 00 00 00 00 00 00 00 00 00 00 00 00 00 00 00 00 00 00 00 00 00 00 00 00 00 00 00 00 00 00 00 00 00 00 00 00 00 00 00 00 00 00 00 00 00 00 00 00 00 00 00 00 00 00 00 00 00 00 00 00 00 00 00 00 00 00 00 00 00 00 00 00 00 00 00 00 00 00 00 00 00 00 00 00 00 00 00 00 00 00 00 00 00 00 00 00 00 00
					39 01 00 00 00 00 26 D8 00 01 00 1D 00 06 74 00 4E 74 00 74 00 74 00 5C 00 FF 09 00 1D 00 00 00 00 00 00 00 00 00 00 00 00 00 00 00 00
					39 01 00 00 00 00 32 D3 37 00 00 01 1A 37 00 00 01 1a 77 77 77 07 82 00 00 A0 3C AA 00 3E 67 70 10 01 03 33 07 77 07 77 33 33 13 04 00 00 00 00 00 00 00 3C 00 00 01 00 00
					/* DSC */
					15 01 00 00 00 00 02 F7 01
					39 01 00 00 00 00 03 EB 8B 8B
					/* DSC */
					15 01 00 00 00 00 02 53 2C
					39 01 00 00 00 00 03 44 08 5c
					15 01 00 00 00 00 02 35 00
					15 01 00 00 00 00 02 B0 80
					15 01 00 00 00 00 02 E6 01
					39 01 00 00 00 00 72 E4 DC 82 00 40 55 55 01 40 55 55 01 00 00 00 00 40 55 55 01 40 55 55 01 40 55 55 01 40 55 55 01 00 00 00 00 00 00 00 00 40 55 55 01 3F 55 55 FD 00 00 00 00 00 00 00 00 00 00 00 00 00 00 00 00 00 00 00 00 00 00 00 00 40 55 55 01 00 00 3F C0 00 66 60 66 06 00 00 00 00 06 06 00 00 00 00 60 60 00 00 00 00 60 66 06 66 F3 00 33 07 00 00 00 00 00 
					05 01 00 00 78 00 02 11 00
					05 01 00 00 00 00 02 29 00
					15 01 00 00 00 00 02 B0 00
					39 01 00 00 00 00 2F BB 59 C8 C8 C8 C8 C8 C8 C8 C8 C8 4A 48 46 44 42 40 3E 3C 3A 00 FF FF FF FF FF FF FF FF FF 04 00 02 02 46 04 69 5A 00 0C 80 0F FF 0F FF 0F FF
					15 01 00 00 00 00 02 B0 80
					15 01 00 00 00 00 02 E3 2E//avdd=6.7
					07 01 00 00 10 00 02 01 00
					39 01 00 00 01 00 05 2A 00 00 04 37
					39 01 00 00 01 00 05 2B 00 00 08 6F
					];

				qcom,mdss-dsi-60-pr-command = [
					15 01 00 00 00 00 02 B0 00
					39 01 00 00 00 00 09 B3 00 00 02 02 08 00 10 00
					39 01 00 00 00 00 2F BB 59 C8 C8 C8 C8 C8 C8 C8 C8 C8 4A 48 46 44 42 40 3E 3C 3A 00 FF FF FF FF FF FF FF FF FF 04 00 01 01 06 04 69 5A 00 0C 80 0F FF 0F FF 0F FF
					39 01 00 00 00 00 20 C2 00 08 70 00 0C 00 04 00 0C 08 84 00 0C 00 04 00 08 00 08 00 08 00 08 09 60 00 02 00 00 00 6C
					39 01 00 00 00 00 1F C4 70 00 00 00 00 00 01 00 2C 00 2C 00 01 00 00 00 00 00 00 00 00 00 00 00 00 00 10 00 00 03
					39 01 00 00 00 00 86 CF 64 0B 00 00 00 00 00 00 03 20 0C 81 04 04 04 04 04 04 04 04 04 04 04 05 00 FF 00 FF 00 FF 00 FF 00 FF 00 FF 00 FF 00 FF 00 FF 03 FF 03 FF 03 FF 00 FF 00 FF 00 FF 00 FF 00 FF 00 FF 00 FF 00 FF 00 FF 03 FF 03 FF 03 FF 01 35 01 35 01 35 01 35 01 35 01 35 01 35 01 35 01 35 01 35 01 35 01 35 1C 1C 1C 1C 1C 1C 1C 1C 1C 1C 1C 1C 09 9A 09 9A 09 9A 09 9A 09 9A 09 9A 00 00 09 9A 09 9A 09 9A 09 9A 09 9A 19
					15 01 00 00 00 00 02 D6 00
					39 01 00 00 00 00 E6 D7 03 00 03 0C F0 FF 00 08 FF 00 00 00 01 00 01 02 00 01 00 88 00 02 00 00 00 00 00 00 00 00 00 00 00 00 00 00 01 00 03 0C F0 FF 00 08 46 02 00 00 01 00 03 0A F0 FF 00 08 46 02 00 00 00 00 01 0C 80 73 3D 08 2F 02 00 00 00 00 01 0B 80 73 3D 08 2F 02 00 00 00 00 00 00 00 00 00 00 00 00 00 00 00 00 00 00 00 00 00 00 00 00 00 00 01 00 03 0B F0 FF 00 08 46 02 00 00 03 00 03 0C F0 FF 46 08 00 01 00 00 00 00 00 00 00 00 00 00 00 00 00 00 00 00 00 00 00 00 00 00 00 00 00 00 00 00 00 00 00 00 00 00 00 00 00 00 00 00 00 00 00 00 00 00 00 00 00 00 00 00 00 00 00 00 00 00 00 00 00 00 00 00 00 00 00 00 00 00 00 00 00 00 00 00 00 00 00 00 00 00 00 00 00 00 00 00 00 00 00 00 00 00 00 00 00 00 00
					39 01 00 00 00 00 26 D8 00 01 00 26 00 08 76 00 46 74 00 74 00 69 00 5C 00 FF 09 00 26 00 00 00 00 00 00 00 00 00 00 00 00 00 00 00 00
					39 01 00 00 00 00 32 D3 37 00 00 01 1A 37 00 00 01 1a 77 77 77 07 82 00 00 A0 3C AA 00 3E 67 70 10 01 03 33 04 44 07 77 33 33 13 04 00 00 00 00 00 00 00 3C 00 00 01 00 00 
					15 01 00 00 00 00 02 B0 80
					15 01 00 00 00 00 02 E3 2F //avdd=6.4
					];
				qcom,mdss-dsi-90-pr-command = [
					15 01 00 00 00 00 02 B0 00
					39 01 00 00 00 00 09 B3 00 00 02 02 08 00 10 00
					39 01 00 00 00 00 2F BB 59 C8 C8 C8 C8 C8 C8 C8 C8 C8 4A 48 46 44 42 40 3E 3C 3A 00 FF FF FF FF FF FF FF FF FF 04 00 02 02 46 04 69 5A 00 0C 80 0F FF 0F FF 0F FF
					39 01 00 00 00 00 20 C2 00 08 70 00 0C 00 04 00 0C 08 84 00 0C 00 04 00 0C 00 04 00 0C 00 04 08 70 00 02 00 00 00 6C
					39 01 00 00 00 00 1F C4 70 00 00 00 00 00 01 00 22 00 22 00 01 00 00 00 00 00 00 00 00 00 00 00 00 00 10 00 00 03
					39 01 00 00 00 00 86 CF 64 0B 00 00 00 00 00 00 03 20 0C 81 02 02 02 02 02 02 02 02 02 02 02 03 00 FF 00 FF 00 FF 00 FF 00 FF 00 FF 00 FF 00 FF 00 FF 03 FF 03 FF 03 FF 00 FF 00 FF 00 FF 00 FF 00 FF 00 FF 00 FF 00 FF 00 FF 03 FF 03 FF 03 FF 01 1A 01 1A 01 1A 01 1A 01 1A 01 1A 01 1A 01 1A 01 1A 01 1A 01 1A 01 1A 1C 1C 1C 1C 1C 1C 1C 1C 1C 1C 1C 1C 09 9A 09 9A 09 9A 09 9A 09 9A 09 9A 00 00 09 9A 09 9A 09 9A 09 9A 09 9A 19
					15 01 00 00 00 00 02 D6 04
					39 01 00 00 00 00 E6 D7 03 00 03 0C F0 FF 00 08 FF 00 00 00 01 00 01 02 00 01 00 88 00 02 00 00 00 00 00 00 00 00 00 00 00 00 00 00 01 00 03 0C F0 FF 00 08 2E 02 00 00 01 00 03 0A F0 FF 00 08 2E 02 00 00 00 00 01 0C 80 73 2E 08 1A 02 00 00 00 00 01 0B 80 73 2E 08 1A 02 00 00 00 00 00 00 00 00 00 00 00 00 00 00 00 00 00 00 00 00 00 00 00 00 00 00 01 00 03 0B F0 FF 00 08 2E 02 00 00 03 00 03 0C F0 FF 2E 08 00 01 00 00 00 00 00 00 00 00 00 00 00 00 00 00 00 00 00 00 00 00 00 00 00 00 00 00 00 00 00 00 00 00 00 00 00 00 00 00 00 00 00 00 00 00 00 00 00 00 00 00 00 00 00 00 00 00 00 00 00 00 00 00 00 00 00 00 00 00 00 00 00 00 00 00 00 00 00 00 00 00 00 00 00 00 00 00 00 00 00 00 00 00 00 00 00 00 00 00 00
					39 01 00 00 00 00 26 D8 00 01 00 1D 00 06 74 00 4E 74 00 74 00 74 00 5C 00 FF 09 00 1D 00 00 00 00 00 00 00 00 00 00 00 00 00 00 00 00
					39 01 00 00 00 00 32 D3 37 00 00 01 1A 37 00 00 01 1a 77 77 77 07 82 00 00 A0 3C AA 00 3E 67 70 10 01 03 33 07 77 07 77 33 33 13 04 00 00 00 00 00 00 00 3C 00 00 01 00 00 
					15 01 00 00 00 00 02 B0 80
					15 01 00 00 00 00 02 E3 2E//avdd=6.7
					];
				/* add for pr stage --- */

				/* add for mp-stage +++ */
				qcom,mdss-dsi-on-60-mp-command = [
					15 01 00 00 00 00 02 B0 00
					39 01 00 00 00 00 09 B3 00 00 02 02 08 00 10 00
					39 01 00 00 00 00 20 C2 00 08 70 00 0C 00 04 00 0C 08 84 00 0C 00 04 00 08 00 08 00 08 00 08 09 60 00 02 00 00 00 6C
					39 01 00 00 00 00 1F C4 70 00 00 00 00 00 01 00 2C 00 2C 00 01 00 00 00 00 00 00 00 00 00 00 00 00 00 10 00 00 03
					39 01 00 00 00 00 86 CF 64 0B 00 00 00 00 00 00 03 20 0C 81 04 04 04 04 04 04 04 04 04 04 04 05 00 FF 00 FF 00 FF 00 FF 00 FF 00 FF 00 FF 00 FF 00 FF 03 FF 03 FF 03 FF 00 FF 00 FF 00 FF 00 FF 00 FF 00 FF 00 FF 00 FF 00 FF 03 FF 03 FF 03 FF 01 35 01 35 01 35 01 35 01 35 01 35 01 35 01 35 01 35 01 35 01 35 01 35 1C 1C 1C 1C 1C 1C 1C 1C 1C 1C 1C 1C 09 9A 09 9A 09 9A 09 9A 09 9A 09 9A 00 00 09 9A 09 9A 09 9A 09 9A 09 9A 19
					15 01 00 00 00 00 02 D6 00
					39 01 00 00 00 00 E6 D7 03 00 03 0C F0 FF 00 08 FF 00 00 00 01 00 01 02 00 01 00 88 00 02 00 00 00 00 00 00 00 00 00 00 00 00 00 00 01 00 03 0C F0 FF 00 08 46 02 00 00 01 00 03 0A F0 FF 00 08 46 02 00 00 00 00 01 0C 80 73 3D 08 2F 02 00 00 00 00 01 0B 80 73 3D 08 2F 02 00 00 00 00 00 00 00 00 00 00 00 00 00 00 00 00 00 00 00 00 00 00 00 00 00 00 01 00 03 0B F0 FF 00 08 46 02 00 00 03 00 03 0C F0 FF 46 08 00 01 00 00 00 00 00 00 00 00 00 00 00 00 00 00 00 00 00 00 00 00 00 00 00 00 00 00 00 00 00 00 00 00 00 00 00 00 00 00 00 00 00 00 00 00 00 00 00 00 00 00 00 00 00 00 00 00 00 00 00 00 00 00 00 00 00 00 00 00 00 00 00 00 00 00 00 00 00 00 00 00 00 00 00 00 00 00 00 00 00 00 00 00 00 00 00 00 00 00 00
					39 01 00 00 00 00 26 D8 00 01 00 26 00 08 76 00 46 74 00 74 00 69 00 5C 00 FF 09 00 26 00 00 00 00 00 00 00 00 00 00 00 00 00 00 00 00
					39 01 00 00 00 00 32 D3 37 00 00 01 1A 37 00 00 01 1a 77 77 77 07 82 00 00 A0 3C AA 00 3E 67 70 10 01 03 33 04 44 07 77 33 33 13 04 00 00 00 00 00 00 00 3C 00 00 01 00 00
					/* DSC */
					15 01 00 00 00 00 02 F7 01
					39 01 00 00 00 00 03 EB 8B 8B
					/* DSC */
					15 01 00 00 00 00 02 53 2C
					39 01 00 00 00 00 03 44 08 5c
					15 01 00 00 00 00 02 35 00
					15 01 00 00 00 00 02 B0 80
					15 01 00 00 00 00 02 E6 01
					05 01 00 00 78 00 02 11 00
					05 01 00 00 00 00 02 29 00
					15 01 00 00 00 00 02 B0 00
					39 01 00 00 00 00 2F BB 59 C8 C8 C8 C8 C8 C8 C8 C8 C8 4A 48 46 44 42 40 3E 3C 3A 00 FF FF FF FF FF FF FF FF FF 04 00 01 01 06 04 69 5A 00 0C 80 0F FF 0F FF 0F FF
					15 01 00 00 00 00 02 B0 80
					15 01 00 00 00 00 02 E3 2F //avdd=6.4
					07 01 00 00 10 00 02 01 00
					39 01 00 00 01 00 05 2A 00 00 04 37
					39 01 00 00 01 00 05 2B 00 00 08 6F
					];
				qcom,mdss-dsi-on-90-mp-command = [
					15 01 00 00 00 00 02 B0 00
					39 01 00 00 00 00 09 B3 00 00 02 02 08 00 10 00
					39 01 00 00 00 00 20 C2 00 08 70 00 0C 00 04 00 0C 08 84 00 0C 00 04 00 0C 00 04 00 0C 00 04 08 70 00 02 00 00 00 6C
					39 01 00 00 00 00 1F C4 70 00 00 00 00 00 01 00 22 00 22 00 01 00 00 00 00 00 00 00 00 00 00 00 00 00 10 00 00 03
					39 01 00 00 00 00 86 CF 64 0B 00 00 00 00 00 00 03 20 0C 81 02 02 02 02 02 02 02 02 02 02 02 03 00 FF 00 FF 00 FF 00 FF 00 FF 00 FF 00 FF 00 FF 00 FF 03 FF 03 FF 03 FF 00 FF 00 FF 00 FF 00 FF 00 FF 00 FF 00 FF 00 FF 00 FF 03 FF 03 FF 03 FF 01 35 01 35 01 35 01 35 01 35 01 35 01 35 01 35 01 35 01 35 01 35 01 35 1C 1C 1C 1C 1C 1C 1C 1C 1C 1C 1C 1C 09 9A 09 9A 09 9A 09 9A 09 9A 09 9A 00 00 09 9A 09 9A 09 9A 09 9A 09 9A 19
					15 01 00 00 00 00 02 D6 04
					39 01 00 00 00 00 E6 D7 03 00 03 0C F0 FF 00 08 FF 00 00 00 01 00 01 02 00 01 00 88 00 02 00 00 00 00 00 00 00 00 00 00 00 00 00 00 01 00 03 0C F0 FF 00 08 2E 02 00 00 01 00 03 0A F0 FF 00 08 2E 02 00 00 00 00 01 0C 80 73 2E 08 1A 02 00 00 00 00 01 0B 80 73 2E 08 1A 02 00 00 00 00 00 00 00 00 00 00 00 00 00 00 00 00 00 00 00 00 00 00 00 00 00 00 01 00 03 0B F0 FF 00 08 2E 02 00 00 03 00 03 0C F0 FF 2E 08 00 01 00 00 00 00 00 00 00 00 00 00 00 00 00 00 00 00 00 00 00 00 00 00 00 00 00 00 00 00 00 00 00 00 00 00 00 00 00 00 00 00 00 00 00 00 00 00 00 00 00 00 00 00 00 00 00 00 00 00 00 00 00 00 00 00 00 00 00 00 00 00 00 00 00 00 00 00 00 00 00 00 00 00 00 00 00 00 00 00 00 00 00 00 00 00 00 00 00 00 00
					39 01 00 00 00 00 26 D8 00 01 00 1D 00 06 74 00 4E 74 00 74 00 74 00 5C 00 FF 09 00 1D 00 00 00 00 00 00 00 00 00 00 00 00 00 00 00 00
					39 01 00 00 00 00 32 D3 37 00 00 01 1A 37 00 00 01 1a 77 77 77 07 82 00 00 A0 3C AA 00 3E 67 70 10 01 03 33 07 77 07 77 33 33 13 04 00 00 00 00 00 00 00 3C 00 00 01 00 00
					/* DSC */
					15 01 00 00 00 00 02 F7 01
					39 01 00 00 00 00 03 EB 8B 8B
					/* DSC */
					15 01 00 00 00 00 02 53 2C
					39 01 00 00 00 00 03 44 08 5c
					15 01 00 00 00 00 02 35 00
					15 01 00 00 00 00 02 B0 80
					15 01 00 00 00 00 02 E6 01
					39 01 00 00 00 00 72 E4 DC 82 00 40 55 55 01 40 55 55 01 00 00 00 00 40 55 55 01 40 55 55 01 40 55 55 01 40 55 55 01 00 00 00 00 00 00 00 00 40 55 55 01 3F 55 55 FD 00 00 00 00 00 00 00 00 00 00 00 00 00 00 00 00 00 00 00 00 00 00 00 00 40 55 55 01 00 00 3F C0 00 66 60 66 06 00 00 00 00 06 06 00 00 00 00 60 60 00 00 00 00 60 66 06 66 F3 00 33 07 00 00 00 00 00
					05 01 00 00 78 00 02 11 00
					05 01 00 00 00 00 02 29 00
					15 01 00 00 00 00 02 B0 00
					39 01 00 00 00 00 2F BB 59 C8 C8 C8 C8 C8 C8 C8 C8 C8 4A 48 46 44 42 40 3E 3C 3A 00 FF FF FF FF FF FF FF FF FF 04 00 02 02 46 04 69 5A 00 0C 80 0F FF 0F FF 0F FF
					15 01 00 00 00 00 02 B0 80
					15 01 00 00 00 00 02 E3 2E//avdd=6.7
					07 01 00 00 10 00 02 01 00
					39 01 00 00 01 00 05 2A 00 00 04 37
					39 01 00 00 01 00 05 2B 00 00 08 6F
					];

				qcom,mdss-dsi-60-mp-command = [
					15 01 00 00 00 00 02 B0 00
					39 01 00 00 00 00 09 B3 00 00 02 02 08 00 10 00
					39 01 00 00 00 00 2F BB 59 C8 C8 C8 C8 C8 C8 C8 C8 C8 4A 48 46 44 42 40 3E 3C 3A 00 FF FF FF FF FF FF FF FF FF 04 00 01 01 06 04 69 5A 00 0C 80 0F FF 0F FF 0F FF
					39 01 00 00 00 00 20 C2 00 08 70 00 0C 00 04 00 0C 08 84 00 0C 00 04 00 08 00 08 00 08 00 08 09 60 00 02 00 00 00 6C
					39 01 00 00 00 00 1F C4 70 00 00 00 00 00 01 00 2C 00 2C 00 01 00 00 00 00 00 00 00 00 00 00 00 00 00 10 00 00 03
					39 01 00 00 00 00 86 CF 64 0B 00 00 00 00 00 00 03 20 0C 81 04 04 04 04 04 04 04 04 04 04 04 05 00 FF 00 FF 00 FF 00 FF 00 FF 00 FF 00 FF 00 FF 00 FF 03 FF 03 FF 03 FF 00 FF 00 FF 00 FF 00 FF 00 FF 00 FF 00 FF 00 FF 00 FF 03 FF 03 FF 03 FF 01 35 01 35 01 35 01 35 01 35 01 35 01 35 01 35 01 35 01 35 01 35 01 35 1C 1C 1C 1C 1C 1C 1C 1C 1C 1C 1C 1C 09 9A 09 9A 09 9A 09 9A 09 9A 09 9A 00 00 09 9A 09 9A 09 9A 09 9A 09 9A 19
					15 01 00 00 00 00 02 D6 00
					39 01 00 00 00 00 E6 D7 03 00 03 0C F0 FF 00 08 FF 00 00 00 01 00 01 02 00 01 00 88 00 02 00 00 00 00 00 00 00 00 00 00 00 00 00 00 01 00 03 0C F0 FF 00 08 46 02 00 00 01 00 03 0A F0 FF 00 08 46 02 00 00 00 00 01 0C 80 73 3D 08 2F 02 00 00 00 00 01 0B 80 73 3D 08 2F 02 00 00 00 00 00 00 00 00 00 00 00 00 00 00 00 00 00 00 00 00 00 00 00 00 00 00 01 00 03 0B F0 FF 00 08 46 02 00 00 03 00 03 0C F0 FF 46 08 00 01 00 00 00 00 00 00 00 00 00 00 00 00 00 00 00 00 00 00 00 00 00 00 00 00 00 00 00 00 00 00 00 00 00 00 00 00 00 00 00 00 00 00 00 00 00 00 00 00 00 00 00 00 00 00 00 00 00 00 00 00 00 00 00 00 00 00 00 00 00 00 00 00 00 00 00 00 00 00 00 00 00 00 00 00 00 00 00 00 00 00 00 00 00 00 00 00 00 00 00
					39 01 00 00 00 00 26 D8 00 01 00 26 00 08 76 00 46 74 00 74 00 69 00 5C 00 FF 09 00 26 00 00 00 00 00 00 00 00 00 00 00 00 00 00 00 00
					39 01 00 00 00 00 32 D3 37 00 00 01 1A 37 00 00 01 1a 77 77 77 07 82 00 00 A0 3C AA 00 3E 67 70 10 01 03 33 04 44 07 77 33 33 13 04 00 00 00 00 00 00 00 3C 00 00 01 00 00
					15 01 00 00 00 00 02 B0 80
					15 01 00 00 00 00 02 E3 2F //avdd=6.4
					];
				qcom,mdss-dsi-90-mp-command = [
					15 01 00 00 00 00 02 B0 00
					39 01 00 00 00 00 09 B3 00 00 02 02 08 00 10 00
					39 01 00 00 00 00 2F BB 59 C8 C8 C8 C8 C8 C8 C8 C8 C8 4A 48 46 44 42 40 3E 3C 3A 00 FF FF FF FF FF FF FF FF FF 04 00 02 02 46 04 69 5A 00 0C 80 0F FF 0F FF 0F FF
					39 01 00 00 00 00 20 C2 00 08 70 00 0C 00 04 00 0C 08 84 00 0C 00 04 00 0C 00 04 00 0C 00 04 08 70 00 02 00 00 00 6C
					39 01 00 00 00 00 1F C4 70 00 00 00 00 00 01 00 22 00 22 00 01 00 00 00 00 00 00 00 00 00 00 00 00 00 10 00 00 03
					39 01 00 00 00 00 86 CF 64 0B 00 00 00 00 00 00 03 20 0C 81 02 02 02 02 02 02 02 02 02 02 02 03 00 FF 00 FF 00 FF 00 FF 00 FF 00 FF 00 FF 00 FF 00 FF 03 FF 03 FF 03 FF 00 FF 00 FF 00 FF 00 FF 00 FF 00 FF 00 FF 00 FF 00 FF 03 FF 03 FF 03 FF 01 35 01 35 01 35 01 35 01 35 01 35 01 35 01 35 01 35 01 35 01 35 01 35 1C 1C 1C 1C 1C 1C 1C 1C 1C 1C 1C 1C 09 9A 09 9A 09 9A 09 9A 09 9A 09 9A 00 00 09 9A 09 9A 09 9A 09 9A 09 9A 19
					15 01 00 00 00 00 02 D6 04
					39 01 00 00 00 00 E6 D7 03 00 03 0C F0 FF 00 08 FF 00 00 00 01 00 01 02 00 01 00 88 00 02 00 00 00 00 00 00 00 00 00 00 00 00 00 00 01 00 03 0C F0 FF 00 08 2E 02 00 00 01 00 03 0A F0 FF 00 08 2E 02 00 00 00 00 01 0C 80 73 2E 08 1A 02 00 00 00 00 01 0B 80 73 2E 08 1A 02 00 00 00 00 00 00 00 00 00 00 00 00 00 00 00 00 00 00 00 00 00 00 00 00 00 00 01 00 03 0B F0 FF 00 08 2E 02 00 00 03 00 03 0C F0 FF 2E 08 00 01 00 00 00 00 00 00 00 00 00 00 00 00 00 00 00 00 00 00 00 00 00 00 00 00 00 00 00 00 00 00 00 00 00 00 00 00 00 00 00 00 00 00 00 00 00 00 00 00 00 00 00 00 00 00 00 00 00 00 00 00 00 00 00 00 00 00 00 00 00 00 00 00 00 00 00 00 00 00 00 00 00 00 00 00 00 00 00 00 00 00 00 00 00 00 00 00 00 00 00
					39 01 00 00 00 00 26 D8 00 01 00 1D 00 06 74 00 4E 74 00 74 00 74 00 5C 00 FF 09 00 1D 00 00 00 00 00 00 00 00 00 00 00 00 00 00 00 00
					39 01 00 00 00 00 32 D3 37 00 00 01 1A 37 00 00 01 1a 77 77 77 07 82 00 00 A0 3C AA 00 3E 67 70 10 01 03 33 07 77 07 77 33 33 13 04 00 00 00 00 00 00 00 3C 00 00 01 00 00
					15 01 00 00 00 00 02 B0 80
					15 01 00 00 00 00 02 E3 2E//avdd=6.7
					];
				/* add for mp stage --- */

				iris,abyp-panel-command = [
					07 01 00 00 10 00 02 01 00
					39 01 00 00 01 00 05 2A 00 00 04 37
					39 01 00 00 01 00 05 2B 00 00 08 6F
					];

				/* add for alpm +++ */
				qcom,mdss-dsi-lp1-command = [
					15 01 00 00 00 00 02 B0 00
					39 01 00 00 00 00 20 C2 00 08 70 00 0C 00 04 00 0C 08 84 00 0C 00 04 00 0C 00 04 00 0C 00 04 08 70 00 02 00 00 00 6C
					39 01 00 00 00 00 E0 D7 03 00 03 0C F0 FF 00 08 FF 00 00 00 01 00 01 02 00 01 00 88 00 02 00 00 00 00 00 00 00 00 00 00 00 00 00 00 01 00 03 0C F0 FF 00 08 2E 02 00 00 01 00 03 0A F0 FF 00 08 2E 02 00 00 00 00 01 0C 80 73 2E 08 1A 02 00 00 00 00 01 0B 80 73 2E 08 1A 02 00 00 00 00 00 00 00 00 00 00 00 00 00 00 00 00 00 00 00 00 00 00 00 00 00 00 01 00 03 0B F0 FF 00 08 2E 02 00 00 03 00 03 0C F0 FF 2E 08 00 01 00 00 00 00 00 00 00 00 00 00 00 00 00 00 00 00 00 00 00 00 00 00 00 00 00 00 00 00 00 00 00 00 00 00 00 00 00 00 00 00 00 00 00 00 00 00 00 00 00 00 00 00 00 00 00 00 00 00 00 00 00 00 00 00 00 00 00 00 00 00 00 00 00 00 00 00 00 00 00 00 00 00 00 00 00 00 00 00 00 00 00 00 00
					39 01 00 00 00 00 19 C1 F0 61 00 00 11 00 11 20 02 02 22 02 05 01 04 80 00 10 00 00 00 01 80 01
					39 01 00 00 00 00 42 D1 09 00 30 03 1C 1C 1D 2E 1E 00 00 00 00 00 00 00 00 00 00 00 00 00 00 00 00 00 00 00 00 00 00 00 00 00 00 00 00 00 00 00 00 00 00 00 00 00 00 00 00 00 00 00 00 00 00 00 00 00 00 00 00 00 00 00 01
					39 01 00 00 00 00 26 D8 00 01 00 1D 00 06 74 00 4E 74 00 4E 00 4E 00 5C 00 FF 09 00 1D 00 00 00 00 00 00 00 00 00 00 00 00 00 00 00 00
					15 01 00 00 00 00 02 B0 80
					15 01 00 00 00 00 02 D8 C0

					15 01 00 00 00 00 02 28 00
					15 01 00 00 00 00 02 B0 80
					15 01 00 00 00 00 02 E3 30
					15 01 00 00 00 00 02 B0 00
					39 01 00 00 00 00 32 D3 37 00 00 01 1A 37 00 00 01 1A 77 77 77 07 82 00 00 A0 3C AA 00 3E 67 70 10 01 03 33 04 44 07 77 33 33 13 04 00 00 00 00 00 00 00 3C 00 00 01 00 00

					15 01 00 00 00 00 02 B0 00
					39 01 00 00 00 00 19 C1 F0 61 00 10 10 01 01 30 02 02 22 02 05 01 04 80 00 10 00 00 00 01 80 01
					39 01 00 00 00 00 20 C2 00 08 70 00 0C 00 04 00 0C 08 84 00 0C 00 04 00 08 00 08 00 08 00 08 09 60 00 02 00 00 00 6C
					39 01 00 00 00 00 1F C4 70 00 44 00 44 00 01 00 22 00 22 00 01 00 00 00 00 00 00 00 00 00 00 00 00 00 10 00 00 03
					39 01 00 00 00 00 E0 D7 03 00 03 0C F0 FF 00 08 FF 00 00 00 01 00 01 02 00 01 00 88 00 02 00 00 00 00 00 00 00 00 00 00 00 00 00 00 01 00 03 0C F0 FF 00 08 46 02 00 00 01 00 03 0A F0 FF 00 08 46 02 00 00 00 00 01 0C 80 73 35 08 17 02 00 00 00 00 01 0B 80 73 35 08 17 02 00 00 00 00 00 00 00 00 00 00 00 00 00 00 00 00 00 00 00 00 00 00 00 00 00 00 01 00 03 0B F0 FF 00 08 46 02 00 00 03 00 03 0C F0 FF 46 08 00 01 00 00 00 00 00 00 00 00 00 00 00 00 00 00 00 00 00 00 00 00 00 00 00 00 00 00 00 00 00 00 00 00 00 00 00 00 00 00 00 00 00 00 00 00 00 00 00 00 00 00 00 00 00 00 00 00 00 00 00 00 00 00 00 00 00 00 00 00 00 00 00 00 00 00 00 00 00 00 00 00 00 00 00 00 00 00 00 00 00 00 00 00 00
					39 01 00 00 00 00 26 D8 00 01 00 1C 00 06 56 00 4E 56 00 56 00 69 00 5C 00 FF 09 00 1C 00 00 00 00 00 00 00 00 00 00 00 00 00 00 00 00
					15 01 00 00 00 00 02 B0 80
					15 01 00 00 00 00 02 D8 C0
					15 01 00 00 96 00 02 39 00
					15 01 00 00 00 00 02 29 00
				];
				qcom,mdss-dsi-nolp-command = [
					15 01 00 00 00 00 02 28 00
					15 01 00 00 00 00 02 B0 80
					15 01 00 00 00 00 02 E3 2E
					15 01 00 00 00 00 02 B0 80
					15 01 00 00 00 00 02 E6 80
					15 01 00 00 64 00 02 38 00
					15 01 00 00 00 00 02 13 00

					15 01 00 00 00 00 02 B0 00
					39 01 00 00 00 00 19 C1 70 61 00 00 11 00 11 20 02 02 22 02 05 01 04 80 00 10 00 00 00 01 80 00
					39 01 00 00 00 00 20 C2 00 08 70 00 0C 00 04 00 0C 08 84 00 0C 00 04 00 0C 00 04 00 0C 00 04 08 70 00 02 00 00 00 6C
					39 01 00 00 00 00 1F C4 70 00 00 00 00 00 01 00 23 00 23 00 01 00 00 00 00 00 00 00 00 00 00 00 00 00 10 00 00 03
					39 01 00 00 00 00 E0 D7 03 00 03 0C F0 FF 00 08 FF 00 00 00 01 00 01 02 00 01 00 88 00 02 00 00 00 00 00 00 00 00 00 00 00 00 00 00 01 00 03 0C F0 FF 00 08 2E 02 00 00 01 00 03 0A F0 FF 00 08 2E 02 00 00 00 00 01 0C 80 73 2E 08 1A 02 00 00 00 00 01 0B 80 73 2E 08 1A 02 00 00 00 00 00 00 00 00 00 00 00 00 00 00 00 00 00 00 00 00 00 00 00 00 00 00 01 00 03 0B F0 FF 00 08 2E 02 00 00 03 00 03 0C F0 FF 2E 08 00 01 00 00 00 00 00 00 00 00 00 00 00 00 00 00 00 00 00 00 00 00 00 00 00 00 00 00 00 00 00 00 00 00 00 00 00 00 00 00 00 00 00 00 00 00 00 00 00 00 00 00 00 00 00 00 00 00 00 00 00 00 00 00 00 00 00 00 00 00 00 00 00 00 00 00 00 00 00 00 00 00 00 00 00 00 00 00 00 00 00 00 00 00 00
					39 01 00 00 00 00 26 D8 00 01 00 1D 00 06 4E 00 4E 74 00 4E 00 4E 00 5C 00 FF 09 00 1D 00 00 00 00 00 00 00 00 00 00 00 00 00 00 00 00
					15 01 00 00 00 00 02 B0 80
					39 01 00 00 00 00 5A DF 53 09 00 00 00 10 00 10 1A 32 28 50 55 55 55 55 50 55 55 55 55 50 00 00 00 00 03 84 00 00 00 7A 37 00 00 00 33 32 00 00 60 07 60 07 00 60 01 00 00 00 00 00 00 00 00 00 00 00 04 03 00 00 00 00 00 00 00 00 4C 00 01 00 00 00 00 00 00 00 00 00 00 00 00 00 00 00 00 00 00
					15 01 00 00 00 00 02 29 00
				];
				qcom,mdss-dsi-nolp-60-command = [
					15 01 00 00 00 00 02 28 00
					15 01 00 00 00 00 02 B0 80
					15 01 00 00 00 00 02 E3 2F
					15 01 00 00 00 00 02 B0 80
					15 01 00 00 00 00 02 E6 80
					15 01 00 00 64 00 02 38 00
					15 01 00 00 00 00 02 13 00

					15 01 00 00 00 00 02 B0 80
					39 01 00 00 00 00 5A DF 53 09 00 00 00 10 00 10 1A 32 28 50 55 55 55 55 50 55 55 55 55 50 00 00 00 00 03 84 00 00 00 7A 37 00 00 00 33 32 00 00 60 07 60 07 00 60 01 00 00 00 00 00 00 00 00 00 00 00 04 03 00 00 00 00 00 00 00 00 4C 00 01 00 00 00 00 00 00 00 00 00 00 00 00 00 00 00 00 00 00
					15 01 00 00 00 00 02 29 00
				];

				qcom,mdss-dsi-lp1-pr-command = [
					15 01 00 00 00 00 02 28 00
					15 01 00 00 00 00 02 B0 80
					15 01 00 00 00 00 02 E3 30
					15 01 00 00 00 00 02 B0 00
					39 01 00 00 00 00 32 D3 37 00 00 01 1A 37 00 00 01 1A 77 77 77 07 82 00 00 A0 3C AA 00 3E 67 70 10 01 03 33 04 44 07 77 33 33 13 04 00 00 00 00 00 00 00 3C 00 00 01 00 00

					15 01 00 00 00 00 02 B0 00
					39 01 00 00 00 00 19 C1 F0 61 00 10 10 01 01 30 02 02 22 02 05 01 04 80 00 10 00 00 00 01 80 01
					39 01 00 00 00 00 20 C2 00 08 70 00 0C 00 04 00 0C 08 84 00 0C 00 04 00 08 00 08 00 08 00 08 09 60 00 02 00 00 00 6C
					39 01 00 00 00 00 1F C4 70 00 44 00 44 00 01 00 22 00 22 00 01 00 00 00 00 00 00 00 00 00 00 00 00 00 10 00 00 03
					39 01 00 00 00 00 E0 D7 03 00 03 0C F0 FF 00 08 FF 00 00 00 01 00 01 02 00 01 00 88 00 02 00 00 00 00 00 00 00 00 00 00 00 00 00 00 01 00 03 0C F0 FF 00 08 46 02 00 00 01 00 03 0A F0 FF 00 08 46 02 00 00 00 00 01 0C 80 73 35 08 17 02 00 00 00 00 01 0B 80 73 35 08 17 02 00 00 00 00 00 00 00 00 00 00 00 00 00 00 00 00 00 00 00 00 00 00 00 00 00 00 01 00 03 0B F0 FF 00 08 46 02 00 00 03 00 03 0C F0 FF 46 08 00 01 00 00 00 00 00 00 00 00 00 00 00 00 00 00 00 00 00 00 00 00 00 00 00 00 00 00 00 00 00 00 00 00 00 00 00 00 00 00 00 00 00 00 00 00 00 00 00 00 00 00 00 00 00 00 00 00 00 00 00 00 00 00 00 00 00 00 00 00 00 00 00 00 00 00 00 00 00 00 00 00 00 00 00 00 00 00 00 00 00 00 00 00 00
					39 01 00 00 00 00 26 D8 00 01 00 1C 00 06 56 00 4E 56 00 56 00 69 00 5C 00 FF 09 00 1C 00 00 00 00 00 00 00 00 00 00 00 00 00 00 00 00
					15 01 00 00 00 00 02 B0 80
					15 01 00 00 00 00 02 D8 C0
					15 01 00 00 96 00 02 39 00
					15 01 00 00 00 00 02 29 00
				];
				/* add for alpm --- */

				qcom,mdss-dsi-on-command-state = "dsi_lp_mode";
				qcom,mdss-dsi-off-command-state = "dsi_hs_mode";
				/* add for dfps +++ */
				qcom,mdss-dsi-60-command-state = "dsi_hs_mode";
				qcom,mdss-dsi-90-command-state = "dsi_hs_mode";
				qcom,mdss-dsi-on-60-command-state = "dsi_lp_mode";
				/* add for dfps --- */

				/* add for pr stage +++ */
				qcom,mdss-dsi-on-60-pr-command-state = "dsi_lp_mode";
				qcom,mdss-dsi-on-90-pr-command-state = "dsi_lp_mode";
				qcom,mdss-dsi-60-pr-command-state = "dsi_hs_mode";
				qcom,mdss-dsi-90-pr-command-state = "dsi_hs_mode";
				/* add for pr stage +++ */

				/* add for mp stage +++ */
				qcom,mdss-dsi-on-60-mp-command-state = "dsi_lp_mode";
				qcom,mdss-dsi-on-90-mp-command-state = "dsi_lp_mode";
				qcom,mdss-dsi-60-mp-command-state = "dsi_hs_mode";
				qcom,mdss-dsi-90-mp-command-state = "dsi_hs_mode";
				/* add for mp stage +++ */

				/* add for alpm +++ */
				qcom,mdss-dsi-lp1-command-state = "dsi_lp_mode";
				qcom,mdss-dsi-lp1-pr-command-state = "dsi_lp_mode";
				qcom,mdss-dsi-nolp-command-state = "dsi_lp_mode";
				qcom,mdss-dsi-nolp-60-command-state = "dsi_lp_mode";
				/* add for alpm --- */
				qcom,compression-mode = "dsc";
				qcom,mdss-dsc-slice-height = <16>;
				qcom,mdss-dsc-slice-width = <1080>;
				qcom,mdss-dsc-slice-per-pkt = <1>;
				qcom,mdss-dsc-bit-per-component = <8>;
				qcom,mdss-dsc-bit-per-pixel = <8>;
				qcom,mdss-dsc-block-prediction-enable;
			};
		};
	};
};
