/* Copyright (c) 2016-2017, The Linux Foundation. All rights reserved.
 *
 * This program is free software; you can redistribute it and/or modify
 * it under the terms of the GNU General Public License version 2 and
 * only version 2 as published by the Free Software Foundation.
 *
 * This program is distributed in the hope that it will be useful,
 * but WITHOUT ANY WARRANTY; without even the implied warranty of
 * MERCHANTABILITY or FITNESS FOR A PARTICULAR PURPOSE.  See the
 * GNU General Public License for more details.
 */

&mdss_mdp {
	dsi_r66455_fhd_cmd: qcom,mdss_dsi_r66455_fhd_cmd_display{
		qcom,mdss-dsi-panel-name =
			"ASUS TM r66455 cmd fhd amoled panel";
		qcom,mdss-dsi-panel-type = "dsi_cmd_mode";
		qcom,mdss-dsi-virtual-channel-id = <0>;
		qcom,mdss-dsi-stream = <0>;
		qcom,mdss-dsi-bpp = <24>;
		qcom,mdss-dsi-color-order = "rgb_swap_rgb";
		qcom,mdss-dsi-underflow-color = <0xff>;
		qcom,mdss-dsi-border-color = <0>;
		qcom,mdss-dsi-traffic-mode = "non_burst_sync_event";
		qcom,mdss-dsi-lane-0-state;
		qcom,mdss-dsi-lane-1-state;
		qcom,mdss-dsi-lane-2-state;
		qcom,mdss-dsi-lane-3-state;
		qcom,adjust-timer-wakeup-ms = <1>;
		qcom,mdss-dsi-reset-sequence = <1 10>, <0 10>, <1 10>;
		qcom,mdss-pan-physical-width-dimension = <74>;
		qcom,mdss-pan-physical-height-dimension = <131>;
		qcom,mdss-dsi-dma-trigger = "trigger_sw";
		qcom,mdss-dsi-mdp-trigger = "none";
		qcom,mdss-dsi-lp11-init;
		//qcom,mdss-dsi-wr-mem-start = <0x2c>;
		//qcom,mdss-dsi-wr-mem-continue = <0x3c>;
		qcom,mdss-dsi-te-pin-select = <1>;
		qcom,mdss-dsi-te-dcs-command = <1>;
		qcom,mdss-dsi-te-check-enable;
		qcom,mdss-dsi-te-using-te-pin;
		/*qcom,mdss-dsi-panel-hdr-enabled;
		qcom,mdss-dsi-panel-hdr-color-primaries = <14500 15500 32000
			17000 15500 30000 8000 3000>;
		qcom,mdss-dsi-panel-peak-brightness = <4200000>;
		qcom,mdss-dsi-panel-blackness-level = <3230>;*/

		qcom,mdss-dsi-t-clk-post = <0x09>;
		qcom,mdss-dsi-t-clk-pre = <0x1A>;

		qcom,mdss-dsi-display-timings {
			timing@0{
				qcom,mdss-dsi-panel-framerate = <60>;
				qcom,mdss-dsi-panel-clockrate = <345600000>;
				qcom,mdss-dsi-panel-width = <1080>;
				qcom,mdss-dsi-panel-height = <2160>;
				qcom,mdss-dsi-h-front-porch = <44>;
				qcom,mdss-dsi-h-back-porch = <56>;
				qcom,mdss-dsi-h-pulse-width = <4>;
				qcom,mdss-dsi-h-sync-skew = <0>;
				qcom,mdss-dsi-v-back-porch = <6>;
				qcom,mdss-dsi-v-front-porch = <6>;
				qcom,mdss-dsi-v-pulse-width = <12>;
				qcom,mdss-dsi-h-left-border = <0>;
				qcom,mdss-dsi-h-right-border = <0>;
				qcom,mdss-dsi-v-top-border = <0>;
				qcom,mdss-dsi-v-bottom-border = <0>;
				qcom,mdss-dsi-h-sync-pulse = <0>;
				qcom,mdss-dsi-panel-jitter = <0xa 0x1>;
				qcom,mdss-dsi-panel-phy-timings = [00 0E 03 03 1E 1D 04
					04 02 03 04 00];
				qcom,mdss-dsi-on-command = [
					15 01 00 00 00 00 02 B0 00
					39 01 00 00 00 00 09 B3 00 00 02 02 08 00 10 00
					39 01 00 00 00 00 20 C2 00 08 70 00 0C 00 04 00 0C 00 04 00 0C 00 04 00 08 00 08 00 08 00 08 09 60 00 02 00 00 00 6C
					39 01 00 00 00 00 1F C4 70 00 00 00 00 00 01 00 2C 00 2C 00 01 00 00 00 00 00 00 00 00 00 00 00 00 00 10 00 00 03
					39 01 00 00 00 00 86 CF 64 0B 00 00 00 00 00 00 00 00 0c 81 04 04 04 04 04 04 04 04 04 04 05 05 00 00 00 00 00 00 00 00 00 00 00 00 00 00 00 00 00 00 03 FF 03 1F 03 FF 00 00 00 00 00 00 00 00 00 00 00 00 00 00 00 00 00 00 03 FF 03 1F 03 FF 01 1A 01 1A 01 1A 01 1A 01 1A 01 1A 01 1A 01 1A 01 1A 01 1A 01 1A 01 1A 1A 1A 1A 1A 1A 1A 1A 1A 1A 1A 1A 1A 09 9A 09 9A 09 9A 09 9A 09 9A 09 9A 09 9A 09 9A 09 9A 09 9A 09 9A 09 9A 19
					15 01 00 00 00 00 02 D6 00
					39 01 00 00 00 00 E6 D7 03 00 03 0C F0 FF 00 08 FF 00 00 00 01 00 01 02 00 01 00 88 00 02 00 00 00 00 00 00 00 00 00 00 00 00 00 00 01 00 03 0C F0 FF 00 08 46 02 00 00 01 00 03 0A F0 FF 00 08 46 02 00 00 00 00 01 0C F0 FF 4C 08 1F 02 00 00 00 00 01 0B F0 FF 4C 08 1F 02 00 00 00 00 00 00 00 00 00 00 00 00 00 00 00 00 00 00 00 00 00 00 00 00 00 00 01 00 03 0B F0 FF 00 08 46 02 00 00 03 00 03 0C F0 FF 46 08 00 01 00 00 00 00 00 00 00 00 00 00 00 00 00 00 00 00 00 00 00 00 00 00 00 00 00 00 00 00 00 00 00 00 00 00 00 00 00 00 00 00 00 00 00 00 00 00 00 00 00 00 00 00 00 00 00 00 00 00 00 00 00 00 00 00 00 00 00 00 00 00 00 00 00 00 00 00 00 00 00 00 00 00 00 00 00 00 00 00 00 00 00 00 00 00 00 00 00 00 00
					39 01 00 00 00 00 26 D8 00 01 00 26 00 08 74 00 46 74 00 74 00 69 00 5C 00 FF 09 00 26 00 00 00 00 00 00 00 00 00 00 00 00 00 00 00 00
					/* DSC */
					15 01 00 00 00 00 02 F7 01
					39 01 00 00 00 00 03 EB 8B 8B
					/* DSC */
					15 01 00 00 00 00 02 53 2C
					39 01 00 00 00 00 03 44 08 5c
					15 01 00 00 00 00 02 35 00
					15 01 00 00 00 00 02 B0 80
					15 01 00 00 00 00 02 E6 01
					05 01 00 00 96 00 02 11 00
					05 01 00 00 96 00 02 29 00
					07 01 00 00 10 00 02 01 00
					39 01 00 00 01 00 05 2A 00 00 04 37
					39 01 00 00 01 00 05 2B 00 00 08 6F
					];
				qcom,mdss-dsi-off-command = [
					05 01 00 00 00 00 02 28 00
					05 01 00 00 78 00 02 10 00
					];
				iris,abyp-panel-command = [
					07 01 00 00 10 00 02 01 00
					39 01 00 00 01 00 05 2A 00 00 04 37
					39 01 00 00 01 00 05 2B 00 00 08 6F
					];
				qcom,mdss-dsi-on-command-state = "dsi_lp_mode";
				qcom,mdss-dsi-off-command-state = "dsi_hs_mode";
				qcom,compression-mode = "dsc";
				qcom,mdss-dsc-slice-height = <16>;
				qcom,mdss-dsc-slice-width = <540>;
				qcom,mdss-dsc-slice-per-pkt = <2>;
				qcom,mdss-dsc-bit-per-component = <8>;
				qcom,mdss-dsc-bit-per-pixel = <8>;
				qcom,mdss-dsc-block-prediction-enable;
			};
		};
	};
};
