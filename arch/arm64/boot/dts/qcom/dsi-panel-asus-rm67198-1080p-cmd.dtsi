/* Copyright (c) 2016-2017, The Linux Foundation. All rights reserved.
 *
 * This program is free software; you can redistribute it and/or modify
 * it under the terms of the GNU General Public License version 2 and
 * only version 2 as published by the Free Software Foundation.
 *
 * This program is distributed in the hope that it will be useful,
 * but WITHOUT ANY WARRANTY; without even the implied warranty of
 * MERCHANTABILITY or FITNESS FOR A PARTICULAR PURPOSE.  See the
 * GNU General Public License for more details.
 */

&mdss_mdp {
	dsi_asus_rm67198_1080p_cmd: qcom,mdss_dsi_asus_rm67198_1080p_cmd{
		qcom,mdss-dsi-panel-name = "ASUS rm67198 1080p command mode dsi panel";
		qcom,mdss-dsi-panel-controller = <&mdss_dsi0>;
		qcom,mdss-dsi-panel-type = "dsi_cmd_mode";
		qcom,mdss-dsi-virtual-channel-id = <0>;
		qcom,mdss-dsi-stream = <0>;
		qcom,mdss-dsi-bpp = <24>;
		qcom,mdss-dsi-color-order = "rgb_swap_rgb";
		qcom,mdss-dsi-underflow-color = <0xff>;
		qcom,mdss-dsi-border-color = <0>;
		qcom,mdss-dsi-panel-orientation = "180";
		qcom,mdss-dsi-traffic-mode = "non_burst_sync_event";
		qcom,mdss-dsi-bllp-eof-power-mode;
		qcom,mdss-dsi-bllp-power-mode;
		qcom,mdss-dsi-tx-eot-append;
		qcom,dcs-cmd-by-left;
		qcom,mdss-dsi-lane-0-state;
		qcom,mdss-dsi-lane-1-state;
		qcom,mdss-dsi-lane-2-state;
		qcom,mdss-dsi-lane-3-state;
		qcom,adjust-timer-wakeup-ms = <1>;
		qcom,mdss-dsi-reset-sequence = <1 20>, <0 20>, <1 20>;
		qcom,mdss-pan-physical-width-dimension = <68>;
		qcom,mdss-pan-physical-height-dimension = <121>;
		qcom,mdss-dsi-dma-trigger = "trigger_sw";
		qcom,mdss-dsi-mdp-trigger = "none";
		qcom,mdss-dsi-lp11-init;
		qcom,mdss-dsi-te-pin-select = <1>;
		qcom,mdss-dsi-wr-mem-start = <0x2c>;
		qcom,mdss-dsi-wr-mem-continue = <0x3c>;
		qcom,mdss-dsi-te-dcs-command = <1>;
		qcom,mdss-dsi-te-check-enable;
		qcom,mdss-dsi-te-using-te-pin;
		qcom,mdss-dsi-panel-hdr-enabled;
		qcom,mdss-dsi-panel-hdr-color-primaries = <14500 15500 32000
			17000 15500 30000 8000 3000>;
		qcom,mdss-dsi-panel-peak-brightness = <3500000>;
		qcom,mdss-dsi-panel-blackness-level = <30>;

		qcom,mdss-dsi-display-timings {
			timing@0{
				qcom,mdss-dsi-panel-framerate = <60>;
				qcom,mdss-dsi-panel-width = <1080>;
				qcom,mdss-dsi-panel-height = <1920>;
				qcom,mdss-dsi-h-front-porch = <28>;
				qcom,mdss-dsi-h-back-porch = <36>;
				qcom,mdss-dsi-h-pulse-width = <4>;
				qcom,mdss-dsi-h-sync-skew = <0>;
				qcom,mdss-dsi-v-back-porch = <20>;
				qcom,mdss-dsi-v-front-porch = <20>;
				qcom,mdss-dsi-v-pulse-width = <8>;
				qcom,mdss-dsi-h-left-border = <0>;
				qcom,mdss-dsi-h-right-border = <0>;
				qcom,mdss-dsi-v-top-border = <0>;
				qcom,mdss-dsi-v-bottom-border = <0>;
				qcom,mdss-dsi-h-sync-pulse = <0>;
				qcom,mdss-dsi-panel-jitter = <0x1 0x1>;
                qcom,mdss-dsi-on-command = [29 01 00 00 00 00 02 FE D0
                        29 01 00 00 00 00 02 13 40
                        29 01 00 00 00 00 02 4B 4C
                        29 01 00 00 00 00 02 45 42
                        29 01 00 00 00 00 02 03 04
                        29 01 00 00 00 00 02 04 03
                        29 01 00 00 00 00 02 FE 90
                        29 01 00 00 00 00 02 12 24
                        29 01 00 00 00 00 02 13 49
                        29 01 00 00 00 00 02 14 92
                        29 01 00 00 00 00 02 15 49
                        29 01 00 00 00 00 02 16 92
                        29 01 00 00 00 00 02 17 24
                        29 01 00 00 00 00 02 18 24
                        29 01 00 00 00 00 02 19 49
                        29 01 00 00 00 00 02 1A 92
                        29 01 00 00 00 00 02 1B 49
                        29 01 00 00 00 00 02 1C 92
                        29 01 00 00 00 00 02 1D 24
                        29 01 00 00 00 00 02 1E 24
                        29 01 00 00 00 00 02 1F 49
                        29 01 00 00 00 00 02 20 92
                        29 01 00 00 00 00 02 21 49
                        29 01 00 00 00 00 02 22 92
                        29 01 00 00 00 00 02 23 24
                        29 01 00 00 00 00 02 A3 3A
                        29 01 00 00 00 00 02 AD 00
                        29 01 00 00 00 00 02 98 B7
                        29 01 00 00 00 00 02 FE A0
                        29 01 00 00 00 00 02 2B 18
                        29 01 00 00 00 00 02 FE B0
                        29 01 00 00 00 00 02 24 40
                        29 01 00 00 00 00 02 25 4F
                        29 01 00 00 00 00 02 FE 60
                        29 01 00 00 00 00 02 C4 00
                        29 01 00 00 00 00 02 FE 70
                        29 01 00 00 00 00 02 7D 45
                        29 01 00 00 00 00 02 5D 40
                        29 01 00 00 00 00 02 86 40
                        29 01 00 00 00 00 02 5A 14
                        29 01 00 00 00 00 02 5C 06
                        29 01 00 00 00 00 02 52 00
                        29 01 00 00 00 00 02 A7 02
                        29 01 00 00 00 00 02 A9 2C
                        29 01 00 00 00 00 02 BD 06
                        29 01 00 00 00 00 02 D0 06
                        29 01 00 00 00 00 02 E7 06
                        29 01 00 00 00 00 02 FE 40
                        29 01 00 00 00 00 02 0E 02
                        29 01 00 00 00 00 02 56 00
                        29 01 00 00 00 00 02 FE 00
                        29 01 00 00 00 00 02 C2 08
                        29 01 00 00 00 00 02 51 00
                        29 01 00 00 00 00 02 35 00
                        29 01 00 00 00 00 02 36 01
                        05 01 00 00 64 00 02 11 00
                        05 01 00 00 00 00 02 29 00
                        29 01 00 00 01 00 02 51 f0
                        39 01 00 00 01 00 05 2a 00 00 04 37
                        39 01 00 00 01 00 05 2b 00 00 07 7f];
                qcom,mdss-dsi-off-command = [05 01 00 00 32 00 02 28 00
                                        05 01 00 00 64 00 02 10 00
                                        15 01 00 00 00 00 02 4F 01];
		iris,abyp-panel-command = [
                        39 01 00 00 01 00 05 2a 00 00 04 37
                        39 01 00 00 01 00 05 2b 00 00 07 7f];
		iris,abyp-panel-command-state = "dsi_lp_mode";
                qcom,mdss-dsi-low-bklt-command = [15 01 00 00 00 00 02 FE 60
                        15 01 00 00 00 00 02 C4 80
                        15 01 00 00 00 00 02 FE 70
                        15 01 00 00 00 00 02 7D 35
                        15 01 00 00 00 00 02 5D 60
                        15 01 00 00 00 00 02 86 60
                        15 01 00 00 00 00 02 5A 1E
                        15 01 00 00 00 00 02 5C 36
                        15 01 00 00 00 00 02 FE 00];
                qcom,mdss-dsi-high-bklt-command = [15 01 00 00 00 00 02 FE 60
                        15 01 00 00 00 00 02 C4 00
                        15 01 00 00 00 00 02 FE 70
                        15 01 00 00 00 00 02 7D 45
                        15 01 00 00 00 00 02 5D 40
                        15 01 00 00 00 00 02 86 40
                        15 01 00 00 00 00 02 5A 14
                        15 01 00 00 00 00 02 5C 06
                        15 01 00 00 00 00 02 FE 00];
                qcom,mdss-dsi-hbm-on-command = [15 01 00 00 00 00 02 FE 00
                        15 01 00 00 00 00 02 53 E0
                        15 01 00 00 00 00 02 FE 40
                        15 01 00 00 00 00 02 64 02
                        15 01 00 00 00 00 02 FE 00];
                qcom,mdss-dsi-hbm-off-command = [15 01 00 00 00 00 02 FE 00
                        15 01 00 00 00 00 02 53 20];
                qcom,mdss-dsi-alpm-5nits-command = [15 01 00 00 00 00 02 FE 40
                        15 01 00 00 00 00 02 4C 07
                        15 01 00 00 00 00 02 31 20
                        15 01 00 00 00 00 02 FE 70
                        15 01 00 00 00 00 02 A9 24
                        15 01 00 00 00 00 02 FE D0
                        15 01 00 00 00 00 02 45 41
                        15 01 00 00 00 00 02 FE 00
                        05 01 00 00 00 00 02 39 00];
                qcom,mdss-dsi-alpm-40nits-command = [15 01 00 00 00 00 02 FE 40
                        15 01 00 00 00 00 02 4C 07
                        15 01 00 00 00 00 02 31 20
                        15 01 00 00 00 00 02 FE 70
                        15 01 00 00 00 00 02 A9 5F
                        15 01 00 00 00 00 02 FE D0
                        15 01 00 00 00 00 02 45 41
                        15 01 00 00 00 00 02 FE 00
                        05 01 00 00 00 00 02 39 00];
                qcom,mdss-dsi-alpm-off-command = [15 01 00 00 00 00 02 FE 40
                        15 01 00 00 00 00 02 31 2D
                        15 01 00 00 00 00 02 FE 00
                        05 01 00 00 00 00 02 38 00];
				qcom,mdss-dsi-on-command-state = "dsi_lp_mode";
				qcom,mdss-dsi-off-command-state = "dsi_hs_mode";
			};
		};
	};
};
